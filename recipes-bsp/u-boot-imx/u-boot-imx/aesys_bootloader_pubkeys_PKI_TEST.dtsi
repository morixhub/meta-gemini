/ {

	signature {

		key-Bootloader_code_1_signer_RSA {
			required = "image";
			algo = "sha256,rsa2048";
			rsa,r-squared = <0xa471dce7 0x5d023e78 0xa1a4efe 0x21e08727 0x7047cf87 0xa4491b06 0x92e802ef 0xdc38dca6 0x9cc7bef6 0xfbebd660 0xcf8b3e82 0x512c95be 0x2539ff2b 0xc3812eb3 0x16a9e5da 0x7e04f5e8 0xc0a85c42 0x3b1a72c 0xd34f4819 0x4781713 0xef0d911f 0xed94c731 0x59eb6b00 0xfe90d667 0xaf3abebb 0xf1820943 0x796aae26 0x4716cd3a 0xe1b75b3e 0xa29a819d 0xcf845291 0x9f15e60 0x4f6bca75 0x2877c80e 0x444482d5 0x3c6b6f59 0x8cdd6756 0xbb741d53 0x2afec24f 0xb4af9ec0 0x12fd9fcc 0x45a4340d 0x322aceb9 0xeaa33720 0xa64c305 0x80a0764a 0xe97adf2d 0xf6c37eb 0x130e904d 0x742840be 0x55a41e52 0xa76289cb 0x5064b1d1 0x97d7c1b2 0x9b67fbeb 0x5cfe4b0a 0xa6843407 0x378a7ab3 0xec457c5c 0x39e4e74b 0xdab7e0e0 0x7e2926ae 0x69bda607 0x86d23a08>;
			rsa,modulus = <0xcfac4df6 0xfb2d6797 0x4e795d2d 0x7ef2992 0xea3aba5 0xf7912c5b 0x1f1bf6ca 0x1a7c0d1f 0xb8dbdde9 0x1ce4fd11 0xe0ee8f74 0xb244da05 0xea785ce2 0x47a1ab88 0xc6b88f30 0x2cf2a5b4 0x1ddb3964 0x3f70cdc1 0x220df4a7 0xea50016e 0xe82d5c60 0xc4739615 0xca74d4fa 0x16db138e 0xb4145704 0x50f6c930 0xdc46c515 0x2434ee05 0x2644846f 0xec49554 0xd5dfd354 0xd58dac03 0x8937a64b 0xb621831 0x7b16b521 0xabefc658 0x580a9df9 0x1dfd1b8 0xf1142924 0xbadbb3cb 0xd051052c 0x350c3fec 0x1c5aed32 0x5260811f 0xb0d9fb2e 0x2c5e086c 0xf29afe37 0xedd38b70 0x15a1ac3a 0x1faf877a 0x7349e4fe 0xaced98e2 0x80832b5a 0x7a3e2ed5 0xa8652fea 0xe78d2cff 0x662a2a2 0xab2e9101 0xa1298f54 0x4b9a08a4 0xbdef27e0 0x9b538c63 0x13d75cdb 0xe95c8bb1>;
			rsa,exponent = <0x00 0x10001>;
			rsa,n0-inverse = <0x80df22af>;
			rsa,num-bits = <0x800>;
			key-name-hint = "Bootloader_code_1_signer_RSA";
		};
	};
};
