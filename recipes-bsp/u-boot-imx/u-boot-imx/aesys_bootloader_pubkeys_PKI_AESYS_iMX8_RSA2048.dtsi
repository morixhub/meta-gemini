/ {

	signature {

		key-Bootloader_code_1_signer_RSA {
			required = "image";
			algo = "sha256,rsa2048";
			rsa,r-squared = <0x5bbf8533 0x39c881d5 0xd836ac7e 0x7a58ac33 0x6607a791 0x7891e833 0x2eaf62fd 0x2ef01beb 0xba577087 0xde8af06e 0x8bb963fe 0x84db51e4 0xc86882ca 0x65fc4d87 0x74b69f41 0x85d38baa 0x1710ff79 0xf00349d2 0xc8301d0a 0xdef04f74 0xb1195aa9 0xa57e26b3 0x84fa6b6c 0xd4c607 0xbf152d4c 0xe2a0a273 0x205dcd09 0xf5e9eafc 0xa570f09b 0x81f728ce 0x155159b9 0x6b52742d 0x460153ee 0xab5a774d 0x1986a979 0x9ce4b193 0xe5454524 0xfa9caa5a 0x9f6b0301 0x862eb960 0xf626045b 0x8cf0aae8 0x6433d237 0x765c9077 0x923de05b 0x4f9d1b61 0x4dc1c674 0x9d921006 0x6c6ec7bd 0x4652258e 0xa2984f48 0x1f2bf7ed 0xd1c8cd43 0xf841a9c7 0xc9185a98 0x83840be7 0x2d33efaf 0x417d0d9f 0x31da0047 0x300638ef 0xd346e2f7 0x122d41c4 0xba4653fd 0x47836f68>;
			rsa,modulus = <0xcc393908 0x939f0ea3 0x32dd6160 0xf07999fb 0x951b0a92 0x8d718ada 0x4f8b34db 0x7e137738 0x9f4e444a 0xbe775cce 0x68e59e9d 0x50325b 0xb83c989b 0x3404ce3c 0x5c51ce49 0xe70502db 0x6051d0ef 0x1cb31d28 0x7f3d1afd 0xfea603ed 0xe9c5bd95 0xb1d8a5d8 0xc3c19250 0xabb601a1 0x651b3a56 0x740f5be9 0xd1378cb6 0x17bf55 0x5c6689ca 0xfe9bd575 0x562613de 0x2ec2e468 0xc6a85d90 0xc48b7cb2 0xefff4a5e 0xd16692f 0x5d537f5f 0xa9e1852d 0xdb8ee885 0xfb48473f 0x9089bfdf 0x7c98c0d9 0x8494c986 0x9d9b6024 0x330115ec 0x2dc66026 0x6b1046df 0xf8143972 0x53f2cb18 0x3bbf125e 0x84efb655 0x7a3da07b 0x195343b8 0xc380b1af 0xeb3c3bfd 0x63c494c0 0xe634273e 0x1b861884 0xce37fa2d 0x6955ea79 0xb03edc83 0x5826559b 0x4bfe2341 0x1f028e9d>;
			rsa,exponent = <0x00 0x10001>;
			rsa,n0-inverse = <0xf5ef984b>;
			rsa,num-bits = <0x800>;
			key-name-hint = "Bootloader_code_1_signer_RSA";
		};
	};
};
