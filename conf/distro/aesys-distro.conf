## conf/layer.conf
```bitbake
# We have a conf and classes directory, add to BBPATH
BBPATH .= ":${LAYERDIR}"

# We have recipes-* directories, add to BBFILES
BBFILES += "${LAYERDIR}/recipes-*/*/*.bb \
            ${LAYERDIR}/recipes-*/*/*.bbappend"

BBFILE_COLLECTIONS += "meta-gemini"
BBFILE_PATTERN_meta-gemini = "^${LAYERDIR}/"
BBFILE_PRIORITY_meta-gemini = "10"

BBFILES_DYNAMIC += " \
    chromium-browser-layer:${LAYERDIR}/dynamic-layers/chromium-browser-layer/*/*/*.bb \
    chromium-browser-layer:${LAYERDIR}/dynamic-layers/chromium-browser-layer/*/*/*.bbappend \
    qt6-layer:${LAYERDIR}/dynamic-layers/qt6-layer/*/*/*.bb \ 
    qt6-layer:${LAYERDIR}/dynamic-layers/qt6-layer/*/*/*.bbappend \
"

LAYERDEPENDS_meta-gemini = "core"
LAYERSERIES_COMPAT_meta-gemini = "mickledore scarthgap wrynose"
```

## recipes-bsp/u-boot-imx/u-boot-imx/board/aesys/aesys_2409/Kconfig
```kconfig
if TARGET_AESYS_2409

config SYS_BOARD
	default "aesys_2409"

config SYS_VENDOR
	default "aesys"

config SYS_CONFIG_NAME
	default "aesys_2409"

config IMX_CONFIG
	default "board/aesys/aesys_2409/aesys_2409-lpddr4.cfg"

endif
```

## recipes-bsp/u-boot-imx/u-boot-imx/board/aesys/aesys_2409a/Kconfig
```kconfig
if TARGET_AESYS_2409A

config SYS_BOARD
	default "aesys_2409a"

config SYS_VENDOR
	default "aesys"

config SYS_CONFIG_NAME
	default "aesys_2409a"

config IMX_CONFIG
	default "board/aesys/aesys_2409a/aesys_2409a-lpddr4.cfg"

endif
```

## recipes-bsp/u-boot-imx/u-boot-imx/board/aesys/aesys_2414/Kconfig
```kconfig
if TARGET_AESYS_2414

config SYS_BOARD
	default "aesys_2414"

config SYS_VENDOR
	default "aesys"

config SYS_CONFIG_NAME
	default "aesys_2414"

config IMX_CONFIG
	default "board/aesys/aesys_2414/aesys_2414-lpddr4.cfg"

endif
```

## recipes-bsp/u-boot-imx/u-boot-imx/board/aesys/aesys_2414_2g/Kconfig
```kconfig
if TARGET_AESYS_2414_2G

config SYS_BOARD
	default "aesys_2414_2g"

config SYS_VENDOR
	default "aesys"

config SYS_CONFIG_NAME
	default "aesys_2414_2g"

config IMX_CONFIG
	default "board/aesys/aesys_2414_2g/aesys_2414_2g-lpddr4.cfg"

endif
```

## recipes-bsp/u-boot-imx/u-boot-imx/board/aesys/aesys_2414a/Kconfig
```kconfig
if TARGET_AESYS_2414A

config SYS_BOARD
	default "aesys_2414a"

config SYS_VENDOR
	default "aesys"

config SYS_CONFIG_NAME
	default "aesys_2414a"

config IMX_CONFIG
	default "board/aesys/aesys_2414a/aesys_2414a-lpddr4.cfg"

endif
```

## recipes-bsp/u-boot-imx/u-boot-imx/board/aesys/aesys_2415a/Kconfig
```kconfig
if TARGET_AESYS_2415A

config SYS_BOARD
	default "aesys_2415a"

config SYS_VENDOR
	default "aesys"

config SYS_CONFIG_NAME
	default "aesys_2415a"

config IMX_CONFIG
	default "board/aesys/aesys_2415a/aesys_2415a-lpddr4.cfg"

endif
```

## recipes-bsp/u-boot-imx/u-boot-imx/board/aesys/aesys_2522/Kconfig
```kconfig
if TARGET_AESYS_2522

config SYS_BOARD
	default "aesys_2522"

config SYS_VENDOR
	default "aesys"

config SYS_CONFIG_NAME
	default "aesys_2522"

config IMX_CONFIG
	default "board/aesys/aesys_2522/aesys_2522-lpddr4.cfg"

endif
```

## recipes-bsp/u-boot-imx/u-boot-imx/board/aesys/aesys_2602/Kconfig
```kconfig
if TARGET_AESYS_2602

config SYS_BOARD
	default "aesys_2602"

config SYS_VENDOR
	default "aesys"

config SYS_CONFIG_NAME
	default "aesys_2602"

config IMX_CONFIG
	default "board/aesys/aesys_2602/aesys_2602-lpddr4.cfg"

endif
```

## recipes-bsp/u-boot-imx/u-boot-imx/board/aesys/aesys_2602a/Kconfig
```kconfig
if TARGET_AESYS_2602A

config SYS_BOARD
	default "aesys_2602a"

config SYS_VENDOR
	default "aesys"

config SYS_CONFIG_NAME
	default "aesys_2602a"

config IMX_CONFIG
	default "board/aesys/aesys_2602a/aesys_2602a-lpddr4.cfg"

endif
```
