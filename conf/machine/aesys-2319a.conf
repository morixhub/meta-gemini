## conf/machine/aesys-2319a.conf
```bitbake
#@TYPE: Machine
#@NAME: AESYS 2319A board (NXP i.MX 8M Plus EVK with LPDDR4)
#@SOC: i.MX8MP
#@DESCRIPTION: Machine configuration for AESYS 2319A board
#@MAINTAINER: morix.dev <morix.dev@gmail.com>

# require include/imx8mp-evk.inc
require conf/machine/include/imx8mp-evk.inc

# The device tree name is implicit for LPDDR4, so can't use MACHINE here
KERNEL_DEVICETREE_BASENAME = "aesys_2319a"
KERNEL_DEVICETREE:append = " \
    freescale/${KERNEL_DEVICETREE_BASENAME}_m7.dtb \
"

UBOOT_CONFIG_BASENAME = "aesys_2319a"
UBOOT_CONFIG[fspi] = "${UBOOT_CONFIG_BASENAME}_defconfig"
UBOOT_CONFIG[ndm]  = "${UBOOT_CONFIG_BASENAME}_ndm_defconfig"

# Set DDR FIRMWARE
DDR_FIRMWARE_VERSION = "202006"
DDR_FIRMWARE_NAME = " \
    lpddr4_pmu_train_1d_dmem_${DDR_FIRMWARE_VERSION}.bin \
    lpddr4_pmu_train_1d_imem_${DDR_FIRMWARE_VERSION}.bin \
    lpddr4_pmu_train_2d_dmem_${DDR_FIRMWARE_VERSION}.bin \
    lpddr4_pmu_train_2d_imem_${DDR_FIRMWARE_VERSION}.bin \
"

IMXBOOT_TARGETS_BASENAME = "flash_evk"

# Mainline BSP doesn't support LPDDR4 so it must be set to nxp.
# Also this machine isn't supported by u-boot-fslc but imx8mn-evk.inc already
# set the bootloader to u-boot-imx instead when NXP BSP is used.
IMX_DEFAULT_BSP = "nxp"

# Need to remove all extra args from WIC command, otherwise
# base recipes will include the default option for not touching fstab
# which we do not want in this case
WIC_CREATE_EXTRA_ARGS = ""

# Specify custom disk partitioning
WKS_FILE = "aesys.wks.in"

# Set initial ramdisk image
INITRAMFS_IMAGE = "aesys-initramfs-image"

# Include the initial ramdisk image in the boot partition
IMAGE_BOOT_FILES:append = " \
    initramfs.cpio.gz.u-boot \
"
```

## recipes-bsp/u-boot-imx/u-boot-imx/board/aesys/aesys_2319a/Kconfig
```kconfig
if TARGET_AESYS_2319A

config SYS_BOARD
	default "aesys_2319a"

config SYS_VENDOR
	default "aesys"

config SYS_CONFIG_NAME
	default "aesys_2319a"

config IMX_CONFIG
	default "board/aesys/aesys_2319a/aesys_2319a-lpddr4.cfg"

endif
```

## recipes-bsp/u-boot-imx/u-boot-imx/board/aesys/aesys_2319a_test/Kconfig
```kconfig
if TARGET_AESYS_2319A_TEST

config SYS_BOARD
	default "aesys_2319a_test"

config SYS_VENDOR
	default "aesys"

config SYS_CONFIG_NAME
	default "aesys_2319a_test"

config IMX_CONFIG
	default "board/aesys/aesys_2319a_test/aesys_2319a_test-lpddr4.cfg"

endif
```
